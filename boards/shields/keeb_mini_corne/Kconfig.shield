## boards/shields/keeb_mini_corne/Kconfig.shield
```kconfig
# Copyright (c) 2020 Pete Johanson
# SPDX-License-Identifier: MIT

config SHIELD_KEEB_MINI_CORNE_LEFT
    def_bool $(shields_list_contains,keeb_mini_corne_left)

config SHIELD_KEEB_MINI_CORNE_RIGHT
    def_bool $(shields_list_contains,keeb_mini_corne_right)
```

## boards/shields/typereactive_corne/Kconfig.shield
```kconfig
# Copyright (c) 2020 Pete Johanson
# SPDX-License-Identifier: MIT

config SHIELD_TYPEREACTIVE_CORNE_LEFT
    def_bool $(shields_list_contains,typereactive_corne_left)

config SHIELD_TYPEREACTIVE_CORNE_RIGHT
    def_bool $(shields_list_contains,typereactive_corne_right)
```
